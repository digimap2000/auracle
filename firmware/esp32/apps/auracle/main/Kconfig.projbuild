## firmware/esp32/apps/auracle/main/Kconfig.projbuild
```kconfig
menu "Auracle Bridge Configuration"

    menu "UART (nRF5340 Connection)"

        config AURACLE_UART_PORT_NUM
            int "UART port number"
            default 1
            range 0 2
            help
                UART peripheral for nRF5340 connection (0=UART0, 1=UART1, 2=UART2).

        config AURACLE_UART_TX_PIN
            int "UART TX GPIO pin"
            default 43
            help
                ESP32-S3 GPIO pin for UART TX to nRF5340 RX.

        config AURACLE_UART_RX_PIN
            int "UART RX GPIO pin"
            default 44
            help
                ESP32-S3 GPIO pin for UART RX from nRF5340 TX.

        config AURACLE_UART_BAUD_RATE
            int "UART baud rate"
            default 115200

        config AURACLE_UART_RX_BUF_SIZE
            int "UART RX ring buffer size (bytes)"
            default 2048
            help
                Must hold several NDJSON lines (adv messages can be ~500 bytes).

    endmenu

    menu "WiFi Provisioning"

        config AURACLE_SOFTAP_SSID
            string "SoftAP SSID"
            default "Naim-Auracle"

        config AURACLE_SOFTAP_PASSWORD
            string "SoftAP password (empty = open)"
            default ""

        config AURACLE_SOFTAP_CHANNEL
            int "SoftAP WiFi channel"
            default 1
            range 1 13

        config AURACLE_STA_CONNECT_TIMEOUT_MS
            int "STA connection timeout (ms)"
            default 15000

    endmenu

    menu "Bridge Server"

        config AURACLE_BRIDGE_TCP_PORT
            int "TCP bridge port"
            default 3333
            range 1 65535
            help
                Single-client raw TCP server port. Bytes are forwarded
                bidirectionally between the socket and the nRF UART.

        config AURACLE_BRIDGE_TASK_STACK_SIZE
            int "Bridge task stack size"
            default 6144
            help
                Stack size for the TCP bridge server task.

        config AURACLE_BRIDGE_TASK_PRIORITY
            int "Bridge task priority"
            default 5
            help
                FreeRTOS priority for the TCP bridge server task.

    endmenu

    config AURACLE_MDNS_HOSTNAME
        string "mDNS hostname"
        default "auracle"
        help
            Device reachable at <hostname>.local on the network.

endmenu
```

## firmware/esp32/apps/auracle/sdkconfig.defaults
```kconfig
# Target
CONFIG_IDF_TARGET="esp32s3"

# Flash
CONFIG_ESPTOOLPY_FLASHSIZE_4MB=y

# Partition table
CONFIG_PARTITION_TABLE_CUSTOM=y
CONFIG_PARTITION_TABLE_CUSTOM_FILENAME="partitions.csv"

# HTTP server
CONFIG_HTTPD_MAX_REQ_HDR_LEN=1024
CONFIG_HTTPD_MAX_URI_LEN=512

# Networking — enough sockets for multiple SSE clients + REST
CONFIG_LWIP_MAX_SOCKETS=16

# WiFi
CONFIG_ESP_WIFI_SOFTAP_SUPPORT=y

# FreeRTOS — 1ms tick for responsive UART processing
CONFIG_FREERTOS_HZ=1000

# Console — USB-Serial-JTAG (built-in USB on GPIO 19/20), not UART0
# GPIO 43/44 are used for the protocol UART to the nRF5340, so the
# console must be routed to the USB port instead.
CONFIG_ESP_CONSOLE_USB_SERIAL_JTAG=y

# UART
CONFIG_UART_ISR_IN_IRAM=y

# Task stacks
CONFIG_ESP_SYSTEM_EVENT_TASK_STACK_SIZE=4096
CONFIG_ESP_MAIN_TASK_STACK_SIZE=4096
```
